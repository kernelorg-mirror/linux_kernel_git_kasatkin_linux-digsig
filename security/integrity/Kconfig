## security/integrity/Kconfig
```kconfig
#
config INTEGRITY
	def_bool y
	depends on IMA || EVM

config INTEGRITY_DIGSIG
	boolean "Integrity keyrings support"
	depends on INTEGRITY
	default n
	select CRYPTO_KSIGN_RSA
	help
	  This option enables digital signature verification support
	  using multiple keyrings. It is used by IMA and EVM digital
	  signature extensions.

source security/integrity/ima/Kconfig
source security/integrity/evm/Kconfig
```

## security/integrity/evm/Kconfig
```kconfig
config EVM
	boolean "EVM support"
	depends on SECURITY && KEYS && (TRUSTED_KEYS=y || TRUSTED_KEYS=n)
	select CRYPTO_HMAC
	select CRYPTO_MD5
	select CRYPTO_SHA1
	select ENCRYPTED_KEYS
	default n
	help
	  EVM protects a file's security extended attributes against
	  integrity attacks.

	  If you are unsure how to answer this question, answer N.

config EVM_DIGSIG
	boolean "EVM Digital Signature support"
	depends on EVM
	default n
	select INTEGRITY_DIGSIG
	help
	  This option enables digital signature verification support for EVM.
	  With this feature file metadata can be protected using digital
	  signature instead of HMAC. When building an image,
	  which has to be flashed to different devices, an HMAC cannot
	  be used to sign file metadata, because the HMAC key is different on
	  every device. File metadata can be protected using digital signature.

	  If unsure, say N.
```

## security/integrity/ima/Kconfig
```kconfig
# IBM Integrity Measurement Architecture
#
config IMA
	bool "Integrity Measurement Architecture(IMA)"
	depends on SECURITY
	select INTEGRITY
	select SECURITYFS
	select CRYPTO
	select CRYPTO_HMAC
	select CRYPTO_MD5
	select CRYPTO_SHA1
	select TCG_TPM if !S390
	select TCG_TIS if TCG_TPM
	help
	  The Trusted Computing Group(TCG) runtime Integrity
	  Measurement Architecture(IMA) maintains a list of hash
	  values of executables and other sensitive system files,
	  as they are read or executed. If an attacker manages
	  to change the contents of an important system file
	  being measured, we can tell.

	  If your system has a TPM chip, then IMA also maintains
	  an aggregate integrity value over this list inside the
	  TPM hardware, so that the TPM can prove to a third party
	  whether or not critical system files have been modified.
	  Read <http://www.usenix.org/events/sec04/tech/sailer.html>
	  to learn more about IMA.
	  If unsure, say N.

config IMA_MEASURE_PCR_IDX
	int
	depends on IMA
	range 8 14
	default 10
	help
	  IMA_MEASURE_PCR_IDX determines the TPM PCR register index
	  that IMA uses to maintain the integrity aggregate of the
	  measurement list.  If unsure, use the default 10.

config IMA_AUDIT
	bool
	depends on IMA
	default y
	help
	  This option adds a kernel parameter 'ima_audit', which
	  allows informational auditing messages to be enabled
	  at boot.  If this option is selected, informational integrity
	  auditing messages can be enabled with 'ima_audit=1' on
	  the kernel command line.

config IMA_LSM_RULES
	bool
	depends on IMA && AUDIT && (SECURITY_SELINUX || SECURITY_SMACK)
	default y
	help
	  Disabling this option will disregard LSM based policy rules.

config IMA_APPRAISE
	bool "Appraise integrity measurements"
	depends on IMA
	default n
	help
	  This option enables local measurement integrity appraisal.
	  It requires the system to be labeled with a security extended
	  attribute containing the file hash measurement.  To protect
	  the security extended attributes from offline attack, enable
	  and configure EVM.

	  For more information on integrity appraisal refer to:
	  <http://linux-ima.sourceforge.net>
	  If unsure, say N.

config IMA_APPRAISE_DIGSIG
	boolean "IMA Digital Signature support"
	depends on IMA_APPRAISE
	default n
	select CRYPTO_KSIGN_RSA
	help
	  This option enables RSA signature based integrity appraisal.
	  It requires the system to be labeled with a security extended
	  attribute containing the file digital signature.
	  A file, which is protected with digital signature, is an immutable.
	  Modification of the file will not replace the signature with a hash.
	  Consequent appraisal will fail.
	  
	  To protect the security extended attributes from offline attack,
	  enable and configure EVM.

	  If unsure, say N.
```
